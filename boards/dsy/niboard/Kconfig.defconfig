## drivers/W25M02GW/zephyr/Kconfig
```kconfig
config W25M02GW
	bool "Enable support for the out of tree MAX30003"


config W25M02GW_INIT_PRIORITY
	int "W25M02GW init priority"
	default 90
	help
	  W25M02GW initialization priority.

config ADS1299_SAMPLE_RATE
	int "ADS1299 sample rate"
	default 250
	help
	  ADS1299 sample rate.
```

## drivers/ads1299/zephyr/Kconfig
```kconfig
# Copyright (c) 2019 Nordic Semiconductor
# SPDX-License-Identifier: Apache-2.0

config ADS1299
	bool "Enable support for the out of tree ADS1299"


config ADS1299_INIT_PRIORITY
	int "ADS1299 init priority"
	default 90
	help
	  ADS1299 initialization priority.

config ADS1299_SAMPLE_RATE
	int "ADS1299 sample rate"
	default 250
	help
	  ADS1299 sample rate in Hz
```

## drivers/afe4960/zephyr/Kconfig
```kconfig
# Copyright (c) 2019 Nordic Semiconductor
# SPDX-License-Identifier: Apache-2.0

config AFE4960
	bool "Enable support for the out of tree ADS1299"


config AFE4960_INIT_PRIORITY
	int "AFE4960 init priority"
	default 90
	help
	  AFE4960 initialization priority.
```

## drivers/bme280/zephyr/Kconfig
```kconfig
# Copyright (c) 2019 Nordic Semiconductor
# SPDX-License-Identifier: Apache-2.0

config BME280
	bool "Enable support for the out of tree MAX30003"
```

## drivers/max30001/zephyr/Kconfig
```kconfig
# Copyright (c) 2019 Nordic Semiconductor
# SPDX-License-Identifier: Apache-2.0

config MAX30001
	bool "Enable support for the out of tree MAX30001"


config MAX30001_INIT_PRIORITY
	int "MAX30001 init priority"
	default 90
	help
	  MAX30001 initialization priority.

config MAX30001_ECG
	bool "Enable ECG support"
	depends on MAX30001
	help
	  Enable support for the ECG sensor.

config MAX30001_BIOZ
	bool "Enable BIOZ support"
	depends on MAX30001
	help
	  Enable support for the BIOZ sensor.
```

## drivers/max30003/zephyr/Kconfig
```kconfig
# Copyright (c) 2019 Nordic Semiconductor
# SPDX-License-Identifier: Apache-2.0

config MAX30003
	bool "Enable support for the out of tree MAX30003"


config MAX30003_INIT_PRIORITY
	int "MAX30003 init priority"
	default 90
	help
	  MAX30003 initialization priority.
```

## drivers/max86141/zephyr/Kconfig
```kconfig
# Copyright (c) 2019 Nordic Semiconductor
# SPDX-License-Identifier: Apache-2.0

config MAX86141
	bool "Enable support for the out of tree MAX30003"


config MAX86141_INIT_PRIORITY
	int "MAX86141 init priority"
	default 90
	help
	  MAX86141 initialization priority.
```
